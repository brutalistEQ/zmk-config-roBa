## config/west.yml
```yaml
manifest:
  remotes:
    - name: zmkfirmware
      url-base: https://github.com/zmkfirmware
    - name: kumamuk-git
      url-base: https://github.com/kumamuk-git
    - name: brutalistEQ
      url-base: https://github.com/brutalistEQ
  projects:
    - name: zmk
      remote: zmkfirmware
      revision: v0.3-branch
      import: app/west.yml
    - name: zmk-pmw3610-driver_roba
      remote: brutalistEQ
      revision: automouse-key-keepalive
  self:
    path: config
```
